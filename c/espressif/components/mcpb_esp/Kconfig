## c/espressif/components/mcpb_esp/Kconfig
```kconfig
menu "mcp-broker provider (mcpb_esp)"

    config MCPB_ESP_RX_BUFFER
        int "Receive buffer (bytes)"
        default 8192
        range 512 65536
        help
            Bounds the largest JSON-RPC message the device can receive in one
            WebSocket message. A larger one is refused with code 1009 and the
            connection reopened, never truncated. Also holds the HTTP upgrade
            request during the handshake. Static, allocated once.

    config MCPB_ESP_TX_BUFFER
        int "Reply buffer (bytes)"
        default 4096
        range 256 65536
        help
            The buffer the message handler writes its reply into. A tools/list
            with many tools or a large tool result needs more. Static.

    config MCPB_ESP_TASK_STACK
        int "Provider task stack (bytes)"
        default 6144
        range 3072 32768
        help
            The handler runs on this task, so size it for your JSON layer and
            tool implementations, not only for libmcpb (which needs under 1 KB
            on top of esp-tls).

    config MCPB_ESP_TASK_PRIORITY
        int "Provider task priority"
        default 5
        range 1 24

    config MCPB_ESP_TASK_CORE
        int "Provider task core (-1: any)"
        default -1
        range -1 1

    config MCPB_ESP_POLL_MS
        int "Poll timeout (ms)"
        default 200
        range 10 5000
        help
            How long one poll waits for a message before returning to drain
            the outbox and check the stop flag. Keep it well under the
            broker's provider heartbeat (30 s by default): the broker's ping
            is answered from inside the poll.

    config MCPB_ESP_MULTIPLEX
        bool "Build the multiplexed /providers endpoint (mcpb_mux.h)"
        default n
        help
            Several provider slots on one socket, for a firmware that hosts
            more than one MCP server. Off, the two source files behind it are
            not compiled at all and the image carries none of it; a device
            with one provider uses the dedicated path and leaves this off.
            The provider task in mcpb_esp.h always uses the dedicated path;
            this option makes mcpb_mux_t available to an application that
            runs its own loop.

    config MCPB_ESP_TX_QUEUE_LEN
        int "Outbox depth (messages)"
        default 8
        range 1 64
        help
            Messages queued with mcpb_esp_send from other tasks, waiting for
            the provider task to send them. mcpb_esp_send fails with
            ESP_ERR_NO_MEM when it is full.

endmenu
```

## c/espressif/samples/provider/main/Kconfig.projbuild
```kconfig
menu "Provider sample"

    config SAMPLE_WIFI_SSID
        string "Wi-Fi SSID"
        default "myssid"

    config SAMPLE_WIFI_PASSWORD
        string "Wi-Fi password"
        default "mypassword"

    config SAMPLE_BROKER_HOST
        string "Broker host"
        default "192.168.1.10"
        help
            Host name or address of the mcp-broker. The device dials out, so
            the broker needs no route to the device, only the other way round.

    config SAMPLE_BROKER_PORT
        int "Broker port"
        default 3000
        range 1 65535

    config SAMPLE_BROKER_TLS
        bool "Use TLS (wss://)"
        default n
        help
            Validates the broker's certificate against the bundle built into
            the image, or against the CA below when it is embedded. There is
            no option to skip the check.

    config SAMPLE_BROKER_CA_EMBEDDED
        bool "Trust the CA in main/certs/ca.pem instead of the bundle"
        depends on SAMPLE_BROKER_TLS
        default n
        help
            Put the PEM of the CA your broker's certificate chains to in
            main/certs/ca.pem (for a self-signed broker certificate, the
            certificate itself) and the build embeds it. The broker of this
            repository generates one with "npm run gen-cert" in
            node/packages/broker; c/tests/tls/test-cert.pem is the one the
            C roundtrip uses, and it is test material only.

    config SAMPLE_BROKER_SLOT
        string "Slot name (empty: esp32-<MAC>)"
        default ""
        help
            The name the device publishes under, as /provider/<name> on the
            broker. Empty takes "esp32-" plus the last three bytes of the
            station MAC, so a fleet of identical firmwares gets distinct
            slots without configuration.

    config SAMPLE_BROKER_TOKEN
        string "Provider token (empty: none)"
        default ""
        help
            Sent as X-Provider-Token when the broker has provider
            authentication enabled.

    config SAMPLE_BROKER_AGGREGATE
        bool "Join the _all aggregate slot"
        default y

endmenu
```
